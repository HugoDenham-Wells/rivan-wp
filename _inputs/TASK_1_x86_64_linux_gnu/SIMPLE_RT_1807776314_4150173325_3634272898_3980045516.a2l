/******************************************************************************
* ASAP2 file: SIMPLE_RT_1807776314_4150173325_3634272898_3980045516.a2l
* Code generation for model "SIMPLE_RT".
* Model version : 1.88
* Simulink Coder version : 24.2 (R2024b) 21-Jun-2024
* C source code generated on : Thu Jun 12 14:33:59 2025
* Target selection: ert_linux.tlc
* Embedded hardware selection: ARM Compatible->ARM 8
* Code generation objectives: Unspecified
* Validation result: Not run
* (add additional file header information here)
******************************************************************************/ ASAP2_VERSION 1 71
/* Version 1.71 */
/begin PROJECT ProjectName "Project Comment Goes Here"
/begin HEADER "Header Comments go here" /end HEADER
/begin MODULE ModuleName "Module Comment Goes Here"
/begin IF_DATA XCP
 /begin PROTOCOL_LAYER 0x0100 0x03E8 0x00C8 0x0000 0x0000 0x0000 0x0000 0x0000 0xFF 0xFFFC BYTE_ORDER_MSB_LAST ADDRESS_GRANULARITY_BYTE OPTIONAL_CMD ALLOC_ODT_ENTRY OPTIONAL_CMD ALLOC_ODT OPTIONAL_CMD ALLOC_DAQ OPTIONAL_CMD FREE_DAQ OPTIONAL_CMD GET_DAQ_RESOLUTION_INFO OPTIONAL_CMD GET_DAQ_PROCESSOR_INFO OPTIONAL_CMD START_STOP_SYNCH OPTIONAL_CMD START_STOP_DAQ_LIST OPTIONAL_CMD SET_DAQ_LIST_MODE OPTIONAL_CMD WRITE_DAQ OPTIONAL_CMD SET_DAQ_PTR OPTIONAL_CMD SHORT_DOWNLOAD OPTIONAL_CMD DOWNLOAD OPTIONAL_CMD SHORT_UPLOAD OPTIONAL_CMD UPLOAD OPTIONAL_CMD SET_MTA /end PROTOCOL_LAYER
 /begin DAQ DYNAMIC 0xFFFF 0x0080 0x00 OPTIMISATION_TYPE_DEFAULT ADDRESS_EXTENSION_FREE IDENTIFICATION_FIELD_TYPE_ABSOLUTE GRANULARITY_ODT_ENTRY_SIZE_DAQ_BYTE 0xFF NO_OVERLOAD_INDICATION /begin TIMESTAMP_SUPPORTED 0x0001 SIZE_DWORD UNIT_1US /end TIMESTAMP_SUPPORTED /begin EVENT "50 ms" "50 ms" 0x0000 DAQ 0xFF 0x05 0x07 0x00 /end EVENT /end DAQ
 /begin XCP_ON_TCP_IP 0x0100 0x4542 ADDRESS "100.113.193.31" /end XCP_ON_TCP_IP
/end IF_DATA
/begin MOD_PAR "MOD PAR Comment Goes Here" /end MOD_PAR
/begin MOD_COMMON "Mod Common Comment Here" BYTE_ORDER MSB_LAST ALIGNMENT_BYTE 1 ALIGNMENT_WORD 2 ALIGNMENT_LONG 4 ALIGNMENT_FLOAT32_IEEE 4 ALIGNMENT_FLOAT64_IEEE 8 ALIGNMENT_INT64 8 /end MOD_COMMON
/begin CHARACTERISTIC SIMPLE_RT_P.SineWave1_Amp "" VALUE 0x000193A0 Record_FLOAT64_IEEE 0 SIMPLE_RT_CM_double -1.7E+308 1.7E+308 /end CHARACTERISTIC
/begin CHARACTERISTIC SIMPLE_RT_P.SineWave1_Bias "" VALUE 0x000193A8 Record_FLOAT64_IEEE 0 SIMPLE_RT_CM_double -1.7E+308 1.7E+308 /end CHARACTERISTIC
/begin CHARACTERISTIC SIMPLE_RT_P.SineWave1_Freq "" VALUE 0x000193B0 Record_FLOAT64_IEEE 0 SIMPLE_RT_CM_double -1.7E+308 1.7E+308 /end CHARACTERISTIC
/begin CHARACTERISTIC SIMPLE_RT_P.SineWave1_HCos "" VALUE 0x000193C8 Record_FLOAT64_IEEE 0 SIMPLE_RT_CM_double -1.7E+308 1.7E+308 /end CHARACTERISTIC
/begin CHARACTERISTIC SIMPLE_RT_P.SineWave1_Hsin "" VALUE 0x000193C0 Record_FLOAT64_IEEE 0 SIMPLE_RT_CM_double -1.7E+308 1.7E+308 /end CHARACTERISTIC
/begin CHARACTERISTIC SIMPLE_RT_P.SineWave1_PCos "" VALUE 0x000193D8 Record_FLOAT64_IEEE 0 SIMPLE_RT_CM_double -1.7E+308 1.7E+308 /end CHARACTERISTIC
/begin CHARACTERISTIC SIMPLE_RT_P.SineWave1_PSin "" VALUE 0x000193D0 Record_FLOAT64_IEEE 0 SIMPLE_RT_CM_double -1.7E+308 1.7E+308 /end CHARACTERISTIC
/begin CHARACTERISTIC SIMPLE_RT_P.SineWave1_Phase "" VALUE 0x000193B8 Record_FLOAT64_IEEE 0 SIMPLE_RT_CM_double -1.7E+308 1.7E+308 /end CHARACTERISTIC
/begin CHARACTERISTIC SIMPLE_RT_P.SineWave_Amp "" VALUE 0x00019360 Record_FLOAT64_IEEE 0 SIMPLE_RT_CM_double -1.7E+308 1.7E+308 /end CHARACTERISTIC
/begin CHARACTERISTIC SIMPLE_RT_P.SineWave_Bias "" VALUE 0x00019368 Record_FLOAT64_IEEE 0 SIMPLE_RT_CM_double -1.7E+308 1.7E+308 /end CHARACTERISTIC
/begin CHARACTERISTIC SIMPLE_RT_P.SineWave_Freq "" VALUE 0x00019370 Record_FLOAT64_IEEE 0 SIMPLE_RT_CM_double -1.7E+308 1.7E+308 /end CHARACTERISTIC
/begin CHARACTERISTIC SIMPLE_RT_P.SineWave_HCos "" VALUE 0x00019388 Record_FLOAT64_IEEE 0 SIMPLE_RT_CM_double -1.7E+308 1.7E+308 /end CHARACTERISTIC
/begin CHARACTERISTIC SIMPLE_RT_P.SineWave_Hsin "" VALUE 0x00019380 Record_FLOAT64_IEEE 0 SIMPLE_RT_CM_double -1.7E+308 1.7E+308 /end CHARACTERISTIC
/begin CHARACTERISTIC SIMPLE_RT_P.SineWave_PCos "" VALUE 0x00019398 Record_FLOAT64_IEEE 0 SIMPLE_RT_CM_double -1.7E+308 1.7E+308 /end CHARACTERISTIC
/begin CHARACTERISTIC SIMPLE_RT_P.SineWave_PSin "" VALUE 0x00019390 Record_FLOAT64_IEEE 0 SIMPLE_RT_CM_double -1.7E+308 1.7E+308 /end CHARACTERISTIC
/begin CHARACTERISTIC SIMPLE_RT_P.SineWave_Phase "" VALUE 0x00019378 Record_FLOAT64_IEEE 0 SIMPLE_RT_CM_double -1.7E+308 1.7E+308 /end CHARACTERISTIC
/begin MEASUREMENT SIMPLE_RT_B.Product "" FLOAT64_IEEE SIMPLE_RT_CM_double 0 0 -1.7E+308 1.7E+308 ECU_ADDRESS 0x00019558 /end MEASUREMENT
/begin MEASUREMENT SIMPLE_RT_B.SineWave "" FLOAT64_IEEE SIMPLE_RT_CM_double 0 0 -1.7E+308 1.7E+308 ECU_ADDRESS 0x00019550 /end MEASUREMENT
/begin MEASUREMENT SIMPLE_RT_DW.lastCos "" FLOAT64_IEEE SIMPLE_RT_CM_double 0 0 -1.7E+308 1.7E+308 ECU_ADDRESS 0x00019528 /end MEASUREMENT
/begin MEASUREMENT SIMPLE_RT_DW.lastCos_j "" FLOAT64_IEEE SIMPLE_RT_CM_double 0 0 -1.7E+308 1.7E+308 ECU_ADDRESS 0x00019538 /end MEASUREMENT
/begin MEASUREMENT SIMPLE_RT_DW.lastSin "" FLOAT64_IEEE SIMPLE_RT_CM_double 0 0 -1.7E+308 1.7E+308 ECU_ADDRESS 0x00019520 /end MEASUREMENT
/begin MEASUREMENT SIMPLE_RT_DW.lastSin_m "" FLOAT64_IEEE SIMPLE_RT_CM_double 0 0 -1.7E+308 1.7E+308 ECU_ADDRESS 0x00019530 /end MEASUREMENT
/begin MEASUREMENT SIMPLE_RT_DW.systemEnable "" SLONG SIMPLE_RT_CM_int32 0 0 -2147483648 2147483647 ECU_ADDRESS 0x00019540 /end MEASUREMENT
/begin MEASUREMENT SIMPLE_RT_DW.systemEnable_l "" SLONG SIMPLE_RT_CM_int32 0 0 -2147483648 2147483647 ECU_ADDRESS 0x00019544 /end MEASUREMENT
/begin MEASUREMENT SIMPLE_RT_Y.Q_1 "" FLOAT64_IEEE SIMPLE_RT_CM_double 0 0 -1.7E+308 1.7E+308 ECU_ADDRESS 0x00019500 /end MEASUREMENT
/begin MEASUREMENT SIMPLE_RT_Y.Q_2 "" FLOAT64_IEEE SIMPLE_RT_CM_double 0 0 -1.7E+308 1.7E+308 ECU_ADDRESS 0x00019508 /end MEASUREMENT
/begin COMPU_METHOD /* Name of CompuMethod */ SIMPLE_RT_CM_double "Q = V" /* Conversion Type */ IDENTICAL /* Format */ "%15.10" /* Units */ "" /end COMPU_METHOD
/begin COMPU_METHOD /* Name of CompuMethod */ SIMPLE_RT_CM_int32 "Q = V" /* Conversion Type */ IDENTICAL /* Format */ "%10.0" /* Units */ "" /end COMPU_METHOD
/begin RECORD_LAYOUT Record_FLOAT64_IEEE FNC_VALUES 1 FLOAT64_IEEE COLUMN_DIR DIRECT /end RECORD_LAYOUT
/begin RECORD_LAYOUT Record_SLONG FNC_VALUES 1 SLONG COLUMN_DIR DIRECT /end RECORD_LAYOUT
/begin GROUP SIMPLE_RT "SIMPLE_RT" /* Root */ ROOT
 /begin REF_CHARACTERISTIC SIMPLE_RT_P.SineWave1_Amp SIMPLE_RT_P.SineWave1_Bias SIMPLE_RT_P.SineWave1_Freq SIMPLE_RT_P.SineWave1_HCos SIMPLE_RT_P.SineWave1_Hsin SIMPLE_RT_P.SineWave1_PCos SIMPLE_RT_P.SineWave1_PSin SIMPLE_RT_P.SineWave1_Phase SIMPLE_RT_P.SineWave_Amp SIMPLE_RT_P.SineWave_Bias SIMPLE_RT_P.SineWave_Freq SIMPLE_RT_P.SineWave_HCos SIMPLE_RT_P.SineWave_Hsin SIMPLE_RT_P.SineWave_PCos SIMPLE_RT_P.SineWave_PSin SIMPLE_RT_P.SineWave_Phase /end REF_CHARACTERISTIC
 /begin REF_MEASUREMENT SIMPLE_RT_B.Product SIMPLE_RT_B.SineWave SIMPLE_RT_DW.lastCos SIMPLE_RT_DW.lastCos_j SIMPLE_RT_DW.lastSin SIMPLE_RT_DW.lastSin_m SIMPLE_RT_DW.systemEnable SIMPLE_RT_DW.systemEnable_l SIMPLE_RT_Y.Q_1 SIMPLE_RT_Y.Q_2 /end REF_MEASUREMENT
/end GROUP
/end MODULE
/end PROJECT
/* (add any file trailer comments here) */
/* EOF SIMPLE_RT_1807776314_4150173325_3634272898_3980045516.a2l*/
